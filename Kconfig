## Kconfig
```kconfig
mainmenu "CHCM Config Converter"

config CHCM_WORKBOOK_PATH
  string
  prompt "Excel workbook path"
  default "xlsx/E01 CHCM-1C-2C1V(得邦)_config_Dataset_LEFT_V0.2.xlsx"
  help
    Path to the Excel workbook used by the converter script.

config HB_LB_ANIMATION_ENABLE
  prompt "HB/LB Welcome Enable"
  bool

choice
  prompt  "Project Name"
  default PROJECT_A_SMALL

  config  PROJECT_A_SMALL
    bool "A+SMALL"
  config PROJECT_A_PLUS_PLUS
    bool "A++"
  config PROJECT_A_PLUS
    bool "A+"
endchoice
config PROJECT_NAME
    int
    default 0 if PROJECT_A_SMALL
    default 1 if PROJECT_A_PLUS_PLUS
    default 2 if PROJECT_A_PLUS

choice
  prompt "COM_VERION"
  default COM_VERSION_V5

  config COM_VERSION_V4
    bool "V4.0"

  config COM_VERSION_V5
    bool "V5.0"
endchoice
config SYSTEM_COM_VERION
  int
  default 0 if COM_VERSION_V4
  default 1 if COM_VERSION_V5

choice
  prompt "CVCC IC Type"
  default CVCC_IC_TYPE_NSL20912

  config CVCC_IC_TYPE_TPS929120
    bool "TPS929120"

  config CVCC_IC_TYPE_TPS929160
    bool "TPS929160"

  config CVCC_IC_TYPE_TPS929240
    bool "TPS929240"

  config CVCC_IC_TYPE_NSL20912
    bool "NSL20912"
endchoice

choice
  prompt "CVCC UART Channel"
  default CVCC_UART_CHANNEL_SUB_UARTCAN_1

  config CVCC_UART_CHANNEL_SUB_UARTCAN_0
    bool "SUB_UARTCAN_0"

  config CVCC_UART_CHANNEL_SUB_UARTCAN_1
    bool "SUB_UARTCAN_1"

  config CVCC_UART_CHANNEL_SUB_UARTCAN_2
    bool "SUB_UARTCAN_2"
endchoice

menu "CVCC Output Voltage Table"

config CVCC_OUTPUT_VOLTAGE_LEVELS
  int
  default 18

config CVCC_OUTPUT_VOLTAGE_5V0
  int "BUCK output 5.0V register value"
  range 0 255
  default 68

config CVCC_OUTPUT_VOLTAGE_5V2
  int "BUCK output 5.2V register value"
  range 0 255
  default 66

config CVCC_OUTPUT_VOLTAGE_5V4
  int "BUCK output 5.4V register value"
  range 0 255
  default 63

config CVCC_OUTPUT_VOLTAGE_5V6
  int "BUCK output 5.6V register value"
  range 0 255
  default 60

config CVCC_OUTPUT_VOLTAGE_5V8
  int "BUCK output 5.8V register value"
  range 0 255
  default 58

config CVCC_OUTPUT_VOLTAGE_6V0
  int "BUCK output 6.0V register value"
  range 0 255
  default 55

config CVCC_OUTPUT_VOLTAGE_6V2
  int "BUCK output 6.2V register value"
  range 0 255
  default 52

config CVCC_OUTPUT_VOLTAGE_6V4
  int "BUCK output 6.4V register value"
  range 0 255
  default 49

config CVCC_OUTPUT_VOLTAGE_6V6
  int "BUCK output 6.6V register value"
  range 0 255
  default 47

config CVCC_OUTPUT_VOLTAGE_6V8
  int "BUCK output 6.8V register value"
  range 0 255
  default 44

config CVCC_OUTPUT_VOLTAGE_7V0
  int "BUCK output 7.0V register value"
  range 0 255
  default 42

config CVCC_OUTPUT_VOLTAGE_7V2
  int "BUCK output 7.2V register value"
  range 0 255
  default 39

config CVCC_OUTPUT_VOLTAGE_7V4
  int "BUCK output 7.4V register value"
  range 0 255
  default 36

config CVCC_OUTPUT_VOLTAGE_7V6
  int "BUCK output 7.6V register value"
  range 0 255
  default 34

config CVCC_OUTPUT_VOLTAGE_7V8
  int "BUCK output 7.8V register value"
  range 0 255
  default 31

config CVCC_OUTPUT_VOLTAGE_8V0
  int "BUCK output 8.0V register value"
  range 0 255
  default 28

config CVCC_OUTPUT_VOLTAGE_8V2
  int "BUCK output 8.2V register value"
  range 0 255
  default 26

config CVCC_OUTPUT_VOLTAGE_8V4
  int "BUCK output 8.4V register value"
  range 0 255
  default 23

endmenu
```
